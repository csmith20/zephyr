## boards/microchip/pic32cxbz2_curiosity/Kconfig.pic32cxbz2_curiosity
```kconfig
# Copyright (c) 2024 Microchip
# SPDX-License-Identifier: Apache-2.0

config BOARD_PIC32CXBZ2_CURIOSITY
	select SOC_PIC32CX1012BZ25048
```

## boards/microchip/pic32cxbz2_curiosity/board.yml
```yaml
board:
  name: pic32cxbz2_curiosity
  vendor: microchip
  socs:
    - name: pic32cx1012bz25048
```

## dts/bindings/arm/atmel,pic32cxbz2-sercom.yaml
```yaml
description: Atmel SAM0 multi-protocol (UART, SPI, I2C) SERCOM unit

compatible: "atmel,pic32cxbz2-sercom"

include: base.yaml

properties:
  reg:
    required: true

  interrupts:
    required: true

  clocks:
    required: false
```

## dts/bindings/arm/microchip,pic32cxbz2-sercom.yaml
```yaml
description: Microchip PIC32CXBZ2 multi-protocol (UART, SPI, I2C) SERCOM unit

compatible: "microchip,pic32cxbz2-sercom"

include: base.yaml

properties:
  reg:
    required: true

  interrupts:
    required: true

  clocks:
    required: false
```

## dts/bindings/serial/microchip,pic32cxbz2-uart.yaml
```yaml
description: Microchip PIC32CXBZ2 family USART

compatible: "microchip,pic32cxbz2-uart"

include:
  - name: uart-controller.yaml
  - name: pinctrl-device.yaml

properties:
  reg:
    required: true

  interrupts:
    required: true

  clocks:
    required: false
```

## soc/microchip/pic32cxbz/Kconfig.soc
```kconfig
# Copyright (c) 2024 Microchip

# SPDX-License-Identifier: Apache-2.0

config SOC_FAMILY_MICROCHIP_PIC32CXBZ
	bool

config SOC_FAMILY
	default "microchip_pic32cxbz" if SOC_FAMILY_MICROCHIP_PIC32CXBZ

rsource "*/Kconfig.soc"
```

## soc/microchip/pic32cxbz/pic32cxbz2/Kconfig.soc
```kconfig
# Microchip PIC32CXSG41 MCU series

# Copyright (c) 2024 Microchip

# SPDX-License-Identifier: Apache-2.0

config SOC_SERIES_PIC32CXBZ2
	bool
	select SOC_FAMILY_MICROCHIP_PIC32CXBZ
	help
	  Enable support for Microchip PIC32CXBZ2 Cortex-M4F microcontrollers.
	  Part No.: PIC32CX1012BZ25048

config SOC_SERIES
	default "pic32cxbz2" if SOC_SERIES_PIC32CXBZ2

config SOC_PIC32CX1012BZ25048
	bool
	select SOC_SERIES_PIC32CXBZ2

config SOC
	default "pic32cx1012bz25048" if SOC_PIC32CX1012BZ25048
```

## soc/microchip/pic32cxbz2/Kconfig.soc
```kconfig
# Copyright (c) 2024 Microchip

# SPDX-License-Identifier: Apache-2.0

config SOC_FAMILY_MICROCHIP_PIC32CXBZ
	bool

config SOC_FAMILY
	default "microchip_pic32cxbz" if SOC_FAMILY_MICROCHIP_PIC32CXBZ

config SOC_SERIES_REVISION_N
	bool
	depends on SOC_FAMILY_MICROCHIP_PIC32CXBZ

config SOC_SERIES_REVISION
	string
	default "n" if SOC_SERIES_REVISION_N
	default ""
	depends on SOC_FAMILY_MICROCHIP_PIC32CXBZ

rsource "*/Kconfig.soc"
```

## west.yml
```yaml
# The west manifest file for upstream Zephyr.
#
# The per-installation west configuration file, .west/config, sets the
# path to the project containing this file in the [manifest] section's
# "path" variable.
#
# You are free to create your own manifest files and put them in any
# repository you want, to create your own custom Zephyr installations.
# For example, you could create a manifest file in your own out of
# tree application directory, which would pull this zephyr repository
# in as an ordinary project.
#
# You can pass your manifest repositories to west init when creating a
# new Zephyr installation. See the west documentation for more
# information.

manifest:
  defaults:
    remote: upstream

  remotes:
    - name: upstream
      url-base: https://github.com/zephyrproject-rtos
    - name: babblesim
      url-base: https://github.com/BabbleSim
    - name: chris
      url-base: https://github.com/csmith20

  group-filter: [-babblesim, -optional]

  #
  # Please add items below based on alphabetical order
  projects:
    - name: acpica
      revision: 8d24867bc9c9d81c81eeac59391cda59333affd4
      path: modules/lib/acpica
    - name: bsim
      repo-path: babblesim-manifest
      revision: 9ee22c707970f6621adba0375841c0a609e24628
      path: tools/bsim
      groups:
        - babblesim
    - name: babblesim_base
      remote: babblesim
      repo-path: base
      path: tools/bsim/components
      revision: a3dff9a57f334fb25daa9625841cd64cbfe56681
      groups:
        - babblesim
    - name: babblesim_ext_2G4_libPhyComv1
      remote: babblesim
      repo-path: ext_2G4_libPhyComv1
      path: tools/bsim/components/ext_2G4_libPhyComv1
      revision: aa4951317cc7d84f24152ea38ac9ac21e6d78a76
      groups:
        - babblesim
    - name: babblesim_ext_2G4_phy_v1
      remote: babblesim
      repo-path: ext_2G4_phy_v1
      path: tools/bsim/components/ext_2G4_phy_v1
      revision: 04eeb3c3794444122fbeeb3715f4233b0b50cfbb
      groups:
        - babblesim
    - name: babblesim_ext_2G4_channel_NtNcable
      remote: babblesim
      repo-path: ext_2G4_channel_NtNcable
      path: tools/bsim/components/ext_2G4_channel_NtNcable
      revision: 20a38c997f507b0aa53817aab3d73a462fff7af1
      groups:
        - babblesim
    - name: babblesim_ext_2G4_channel_multiatt
      remote: babblesim
      repo-path: ext_2G4_channel_multiatt
      path: tools/bsim/components/ext_2G4_channel_multiatt
      revision: bde72a57384dde7a4310bcf3843469401be93074
      groups:
        - babblesim
    - name: babblesim_ext_2G4_modem_magic
      remote: babblesim
      repo-path: ext_2G4_modem_magic
      path: tools/bsim/components/ext_2G4_modem_magic
      revision: edfcda2d3937a74be0a59d6cd47e0f50183453da
      groups:
        - babblesim
    - name: babblesim_ext_2G4_modem_BLE_simple
      remote: babblesim
      repo-path: ext_2G4_modem_BLE_simple
      path: tools/bsim/components/ext_2G4_modem_BLE_simple
      revision: 4d2379de510684cd4b1c3bbbb09bce7b5a20bc1f
      groups:
        - babblesim
    - name: babblesim_ext_2G4_device_burst_interferer
      remote: babblesim
      repo-path: ext_2G4_device_burst_interferer
      path: tools/bsim/components/ext_2G4_device_burst_interferer
      revision: 5b5339351d6e6a2368c686c734dc8b2fc65698fc
      groups:
        - babblesim
    - name: babblesim_ext_2G4_device_WLAN_actmod
      remote: babblesim
      repo-path: ext_2G4_device_WLAN_actmod
      path: tools/bsim/components/ext_2G4_device_WLAN_actmod
      revision: 9cb6d8e72695f6b785e57443f0629a18069d6ce4
      groups:
        - babblesim
    - name: babblesim_ext_2G4_device_playback
      remote: babblesim
      repo-path: ext_2G4_device_playback
      path: tools/bsim/components/ext_2G4_device_playback
      revision: abb48cd71ddd4e2a9022f4bf49b2712524c483e8
      groups:
        - babblesim
    - name: babblesim_ext_libCryptov1
      remote: babblesim
      repo-path: ext_libCryptov1
      path: tools/bsim/components/ext_libCryptov1
      revision: 236309584c90be32ef12848077bd6de54e9f4deb
      groups:
        - babblesim
    - name: cmsis
      revision: 4b96cbb174678dcd3ca86e11e1f24bc5f8726da0
      path: modules/hal/cmsis
      groups:
        - hal
    - name: cmsis-dsp
      revision: 6489e771e9c405f1763b52d64a3f17a1ec488ace
      path: modules/lib/cmsis-dsp
    - name: cmsis-nn
      revision: ea987c1ca661be723de83bd159aed815d6cbd430
      path: modules/lib/cmsis-nn
    - name: edtt
      revision: b9ca3c7030518f07b7937dacf970d37a47865a76
      path: tools/edtt
      groups:
        - tools
    - name: fatfs
      revision: 427159bf95ea49b7680facffaa29ad506b42709b
      path: modules/fs/fatfs
      groups:
        - fs

    - name: hal_atmel
      revision: 56d60ebc909ad065bf6554cee73487969857614b
      path: modules/hal/atmel
      groups:
        - hal

    - name: hal_microchip
      remote: chris
      revision: pic32cxsg
      path: modules/hal/microchip
      groups:
        - hal

    - name: hostap
      path: modules/lib/hostap
      revision: 7761b17eea9a2442af6ea9df830904fa4ba7bbca

    - name: liblc3
      revision: 1a5938ebaca4f13fe79ce074f5dee079783aa29f
      path: modules/lib/liblc3
    - name: littlefs
      path: modules/fs/littlefs
      groups:
        - fs
      revision: 009bcff0ed4853a53df8256039fa815bda6854dd
    - name: loramac-node
      revision: fb00b383072518c918e2258b0916c996f2d4eebe
      path: modules/lib/loramac-node
    - name: lvgl
      revision: 2b498e6f36d6b82ae1da12c8b7742e318624ecf5
      path: modules/lib/gui/lvgl
    - name: mbedtls
      revision: fb36f3fe20f9f62e67b1a20c0cfe0a6788ec2bf6
      path: modules/crypto/mbedtls
      groups:
        - crypto
    - name: mcuboot
      revision: 52e2afc2f809c424b0f337f56059d1dfcc7e6d98
      path: bootloader/mcuboot
      groups:
        - bootloader
    - name: mipi-sys-t
      path: modules/debug/mipi-sys-t
      groups:
        - debug
      revision: 71ace1f5caa03e56c8740a09863e685efb4b2360
    - name: net-tools
      revision: a1fb781b67c33e9a6868b0915b627315c5cac668
      path: tools/net-tools
      groups:
        - tools
    - name: nrf_hw_models
      revision: 4b0b020e25dbf1a11ccccf7b7741d6ca991ba9e4
      path: modules/bsim_hw_models/nrf_hw_models
    - name: open-amp
      revision: 76d2168bcdfcd23a9a7dce8c21f2083b90a1e60a
      path: modules/lib/open-amp
    - name: openthread
      revision: e10a92570f94ff1e0bc5e0da9ecf0ee135d955a6
      path: modules/lib/openthread
    - name: percepio
      path: modules/debug/percepio
      revision: b68d17993109b9bee6b45dc8c9794e7b7bce236d
      groups:
        - debug
    - name: picolibc
      path: modules/lib/picolibc
      revision: 764ef4e401a8f4c6a86ab723533841f072885a5b
    - name: segger
      revision: b011c45b585e097d95d9cf93edf4f2e01588d3cd
      path: modules/debug/segger
      groups:
        - debug
    - name: tinycrypt
      revision: 1012a3ebee18c15ede5efc8332ee2fc37817670f
      path: modules/crypto/tinycrypt
      groups:
        - crypto
    - name: trusted-firmware-m
      revision: a11cd27905aecc4416cfc85552bfc3b997375056
      path: modules/tee/tf-m/trusted-firmware-m
      groups:
        - tee
    - name: trusted-firmware-a
      revision: 713ffbf96c5bcbdeab757423f10f73eb304eff07
      path: modules/tee/tf-a/trusted-firmware-a
      groups:
        - tee
    - name: uoscore-uedhoc
      revision: 84ef879a46d7bfd9a423fbfb502b04289861f9ea
      path: modules/lib/uoscore-uedhoc
    - name: zcbor
      revision: 47f34dd7f5284e8750b5a715dee7f77c6c5bdc3f
      path: modules/lib/zcbor

  self:
    path: zephyr
    west-commands: scripts/west-commands.yml
    import: submanifests
```
