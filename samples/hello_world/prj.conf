## CMakeLists.txt
```
# SPDX-License-Identifier: Apache-2.0

cmake_minimum_required(VERSION 3.20.0)

set(MCHP_LIB_DIR  ${CMAKE_CURRENT_SOURCE_DIR}/mchplib)

find_package(Zephyr REQUIRED HINTS $ENV{ZEPHYR_BASE})
project(hello_world)

FILE(GLOB app_sources src/*.c)
target_sources(app PRIVATE src/main.c)


add_library(other3party_lib STATIC IMPORTED GLOBAL)
set_target_properties(other3party_lib PROPERTIES IMPORTED_LOCATION ${MCHP_LIB_DIR}/pic32cx_bz2_device_support.a)

target_link_libraries(app PUBLIC other3party_lib)

#zephyr_library_link_libraries(${MCHP_LIB_DIR}/pic32cx_bz2_device_support.a)
```

## prj.conf
```kconfig
# nothing here
CONFIG_NO_OPTIMIZATIONS=y
#CONFIG_DEBUG_OPTIMIZATIONS=y
CONFIG_FP_HARDABI=y
CONFIG_FPU=y
```

## src/main.c
```c
/*
 * Copyright (c) 2012-2014 Wind River Systems, Inc.
 *
 * SPDX-License-Identifier: Apache-2.0
 */

#include <stdio.h>
#include "rf_system.h"

int main(void)
{
	
	// Initialize the RF Clock Generator
    SYS_ClkGen_Config();
 
    // Initialize RF System
    SYS_Load_Cal(WSS_ENABLE_BLE);
 
	
	printf("Hello World 35! %s\n", CONFIG_BOARD_TARGET);

    while(1);
	return 0;
}
```

## src/rf_system.h
```c
#ifndef RF_SYSTEM_H
#define RF_SYSTEM_H

//#include <xc.h>
#include <stdbool.h>

#ifdef __cplusplus
extern "C" {
#endif

#define HPA_FEM_MODE_DISABLE            0
#define HPA_FEM_MODE_ENABLE             1

/** Wireless Subsystem Enable Flag */
typedef enum 
{
    WSS_ENABLE_NONE, //None
    WSS_ENABLE_BLE,  // BLE Enable
    WSS_ENABLE_ZB,   // Zigbee Enable
    WSS_ENABLE_BLE_ZB //BLE and Zigbee Enable
}wssEnable_t;

// *****************************************************************************
/**
*@brief This routine will load the System calibration values for the RF, and PMU
*       subsystems. The main functions are RF initialization, BLE Modem initialization,
*       load Calibration data from IB, VCO coarse tune (ACLB) and Initialize Arbiter
*
*@param wssEnable_t wssEnable -  wireless subsystem enable flag
*       0: None 
*       1: BLE enable
*       2: ZB enable
*       3: BLE enable & ZB enable
*
*@retval None
*/
void SYS_Load_Cal(wssEnable_t wssEnable);

// *****************************************************************************
/**
*@brief This routine will decide if RF need to be calibrated. current method is 
*       a default 60 sec timer to trigger calibration
*
*@param None
*
*@retval A boolean value: 
*       True means RF need to be calibrated. 
*       False means RF doesn't need to be calibrated
*/

bool RF_NeedCal(void);


// *****************************************************************************
/**
*@brief This routine will calibrate the RF from a Timer event condition. The main 
*       functions are TX_Power_Compensation and RSSI_ED_Compensation, which are
*       compensation over temperature. Since temperature may change over time, user
*       can choose do RF_Timer_Cal over time.
*
*@param wssEnable_t wssEnable -  wireless subsystem enable flag
*       0: None 
*       1: BLE enable
*       2: ZB enable
*       3: BLE enable & ZB enable
*
*@retval None
*/
void RF_Timer_Cal(wssEnable_t wssEnable);


// *****************************************************************************
/**
*@brief This routine will read current temperature ADC value. The functionality is 
*       provided by RF IP.
*
*@param None
*
*@retval uint16    The ADC value of current temperature
*/
uint16_t Temperature_Reading(void);

// *****************************************************************************
/**
*@brief This routine will configure the RF system clock that feeds the MCU.
*
*@param None
*
*@retval None
*/
void SYS_ClkGen_Config(void);

// *****************************************************************************
/**
*@brief This routine will the RF subsystem as idle mode.
*
*@param None
*
*@retval None
*/
void RF_SetIdleMode(void);

// *****************************************************************************
/**
*@brief This routine will enable the FEM module control.
*
*@param None
*@retval None
*/
void  RF_HpaInit();

#ifdef __cplusplus
}
#endif

#endif /* RF_SYSTEM_H_INCLUDED */
```
